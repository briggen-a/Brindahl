## firmware/sdkconfig.defaults
```kconfig
CONFIG_ESPTOOLPY_FLASHSIZE_16MB=y
CONFIG_SPIRAM=y
CONFIG_SPIRAM_MODE_OCT=y
CONFIG_SPIRAM_USE_MALLOC=y
CONFIG_FATFS_LFN_HEAP=y
CONFIG_FATFS_MAX_LFN=128
CONFIG_FATFS_IMMEDIATE_FSYNC=y
CONFIG_HTTPD_MAX_REQ_HDR_LEN=2048
CONFIG_ESP_MAIN_TASK_STACK_SIZE=6144
CONFIG_PARTITION_TABLE_SINGLE_APP_LARGE=y
```
